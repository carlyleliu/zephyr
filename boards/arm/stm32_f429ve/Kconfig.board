## boards/arm/stm32_f429ve/Kconfig.board
```kconfig
# STM32_F429VE  board configuration

# Copyright (c) 2017 Linaro Limited
# SPDX-License-Identifier: Apache-2.0

config BOARD_STM32_F429VE
	bool "F429VE Development Board"
	depends on SOC_STM32F429XX
```

## boards/arm/stm32_f429ve/Kconfig.defconfig
```kconfig
# STM32 F429VE board configuration

# Copyright (c) 2017 Linaro Limited
# SPDX-License-Identifier: Apache-2.0

if BOARD_STM32_F429VE

config BOARD
	default "stm32_f429ve"

if NETWORKING

config NET_L2_ETHERNET
	default y

endif # NETWORKING

endif # BOARD_STM32_F429VE
```
